## config/dts/bindings/behaviors/zmk,behavior-layer-key.yaml
```yaml
description: Tap for one-shot layer, hold for chords, double tap to lock, tap to exit
compatible: "zmk,behavior-layer-key"
include: zero_param.yaml

properties:
  layer:
    type: int
    required: true
  parent-layer:
    type: int
    default: -1
    description: Preserve this parent while held or locked; explicitly exiting it also exits this child
  tapping-term-ms:
    type: int
    default: 400
  release-after-ms:
    type: int
    default: 3000
```

## config/dts/bindings/behaviors/zmk,behavior-layer-modifier.yaml
```yaml
description: Preserve a modifier while a layer key is held; otherwise use its symbol
compatible: "zmk,behavior-layer-modifier"
include: zero_param.yaml

properties:
  layer:
    type: int
    required: true
  bindings:
    type: phandle-array
    required: true
    description: Modifier for a held layer, followed by the ordinary symbol binding
```

## config/dts/bindings/behaviors/zmk,behavior-modifier-key.yaml
```yaml
description: Immediate held modifier, double tap to lock, tap again to unlock
compatible: "zmk,behavior-modifier-key"
include: zero_param.yaml

properties:
  bindings:
    type: phandle-array
    required: true
    description: One ordinary modifier key press binding
  tapping-term-ms:
    type: int
    default: 250
    description: Maximum first-to-second key-down interval for locking; holds have no delay
```
